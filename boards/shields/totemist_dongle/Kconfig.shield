## boards/shields/totemist_dongle/Kconfig.shield
```kconfig
config SHIELD_TOTEMIST_DONGLE_CENTRAL
    def_bool $(shields_list_contains,totemist_dongle_central)

config SHIELD_TOTEMIST_DONGLE_PERIPHERAL_LEFT
    def_bool $(shields_list_contains,totemist_dongle_peripheral_left)

config SHIELD_TOTEMIST_DONGLE_PERIPHERAL_RIGHT
    def_bool $(shields_list_contains,totemist_dongle_peripheral_right)
```

## config/west.yml
```yaml
manifest:
  remotes:
    - name: zmkfirmware
      url-base: https://github.com/zmkfirmware
    - name: infely
      url-base: https://github.com/infely
    - name: xkonni
      url-base: https://github.com/xkonni
    - name: ykiewang
      url-base: https://github.com/ykiewang
  projects:
    - name: zmk
      remote: zmkfirmware
      revision: main
      import: app/west.yml
    - name: nice-view-battery
      remote: infely
      revision: main
    - name: nice-view-glyphs
      remote: xkonni
      revision: main
    - name: zmk-dongle-display
      remote: xkonni
      revision: main
    - name: zmk-keyboards-totem
      url: https://github.com/victorlucachi/zmk-keyboards-totem
      revision: main
      path: modules/zmk-keyboards-totem
    - name: zmk-keybeacon
      remote: ykiewang
      revision: v1.2.0
  self:
    path: config
```
