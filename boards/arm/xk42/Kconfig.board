## boards/arm/xk42/Kconfig.board
```kconfig
# Copyright (c) 2020 The ZMK Contributors
# SPDX-License-Identifier: MIT

config BOARD_XK42_LEFT
	bool "XK42 Left"
	depends on SOC_NRF52840_QIAA

config BOARD_XK42_RIGHT
    bool "XK42 Right"
    depends on SOC_NRF52840_QIAA
```

## boards/shields/corne_choc_pro_dongle/Kconfig.shield
```kconfig
config SHIELD_CORNE_CHOC_PRO_DONGLE_CENTRAL
    def_bool $(shields_list_contains,corne_choc_pro_dongle_central)

config SHIELD_CORNE_CHOC_PRO_DONGLE_PERIPHERAL_LEFT
    def_bool $(shields_list_contains,corne_choc_pro_dongle_peripheral_left)

config SHIELD_CORNE_CHOC_PRO_DONGLE_PERIPHERAL_RIGHT
    def_bool $(shields_list_contains,corne_choc_pro_dongle_peripheral_right)
```

## boards/shields/piantor_pro_bt_dongle/Kconfig.shield
```kconfig
config SHIELD_PIANTOR_PRO_BT_DONGLE_CENTRAL
    def_bool $(shields_list_contains,piantor_pro_bt_dongle_central)

config SHIELD_PIANTOR_PRO_BT_DONGLE_PERIPHERAL_LEFT
    def_bool $(shields_list_contains,piantor_pro_bt_dongle_peripheral_left)

config SHIELD_PIANTOR_PRO_BT_DONGLE_PERIPHERAL_RIGHT
    def_bool $(shields_list_contains,piantor_pro_bt_dongle_peripheral_right)
```

## boards/shields/sofle_dongle/Kconfig.shield
```kconfig
# Copyright (c) 2020 The ZMK Contributors
# SPDX-License-Identifier: MIT

config SHIELD_SOFLE_DONGLE_CENTRAL
    def_bool $(shields_list_contains,sofle_dongle_central)

config SHIELD_SOFLE_DONGLE_PERIPHERAL_LEFT
    def_bool $(shields_list_contains,sofle_dongle_peripheral_left)

config SHIELD_SOFLE_DONGLE_PERIPHERAL_RIGHT
    def_bool $(shields_list_contains,sofle_dongle_peripheral_right)
```

## boards/shields/xk42/Kconfig.defconfig
```kconfig
# SPDX-License-Identifier: MIT

if SHIELD_XK42_LEFT || SHIELD_XK42_RIGHT

config ZMK_KEYBOARD_NAME
    default "XK42"

config ZMK_SPLIT
    default y

# Enable deep sleep
config ZMK_SLEEP
    default y

# Allow P1.00 (NFC pin) to be used as GPIO (Row 2)
config NFCT_PINS_AS_GPIOS
    default y

# Windows Battery Reporting Fix
config BT_GATT_ENFORCE_SUBSCRIPTION
    default n

# ImproveZMK Studio (alpha)
config ZMK_STUDIO
    default y

# Enable d connection stability
config ZMK_BLE_EXPERIMENTAL_CONN
    default y

# Enable RGB underglow
config ZMK_RGB_UNDERGLOW
    default y

config WS2812_STRIP
    default y

config ZMK_RGB_UNDERGLOW_BRT_MAX
    default 20

config ZMK_RGB_UNDERGLOW_HUE_START
    default 48

config ZMK_RGB_UNDERGLOW_SAT_START
    default 96

# Enable I2C for fuel gauge
config I2C
    default y

config SPI
    default y

endif

if SHIELD_XK42_LEFT

config ZMK_SPLIT_ROLE_CENTRAL
    default y

endif
```

## boards/shields/xk42/Kconfig.shield
```kconfig
# SPDX-License-Identifier: MIT

config SHIELD_XK42_LEFT
    def_bool $(shields_list_contains,xk42_left)

config SHIELD_XK42_RIGHT
    def_bool $(shields_list_contains,xk42_right)
```

## boards/shields/xk42_dongle/Kconfig.shield
```kconfig
config SHIELD_XK42_DONGLE_CENTRAL
    def_bool $(shields_list_contains,xk42_dongle_central)

config SHIELD_XK42_DONGLE_PERIPHERAL_LEFT
    def_bool $(shields_list_contains,xk42_dongle_peripheral_left)

config SHIELD_XK42_DONGLE_PERIPHERAL_RIGHT
    def_bool $(shields_list_contains,xk42_dongle_peripheral_right)
```
