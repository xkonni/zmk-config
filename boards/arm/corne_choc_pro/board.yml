## boards/arm/corne_choc_pro/board.yml
```yaml
boards:
  - name: corne_choc_pro_left
    vendor: others
    socs:
      - name: nrf52840
        variants:
          - name: zmk
  - name: corne_choc_pro_right
    vendor: others
    socs:
      - name: nrf52840
        variants:
          - name: zmk
```

## boards/arm/piantor_pro_bt/board.yml
```yaml
boards:
  - name: piantor_pro_bt_left
    vendor: others
    socs:
      - name: nrf52840
        variants:
          - name: zmk
  - name: piantor_pro_bt_right
    vendor: others
    socs:
      - name: nrf52840
        variants:
          - name: zmk
```

## config/west.yml
```yaml
manifest:
  remotes:
    - name: zmkfirmware
      url-base: https://github.com/zmkfirmware
    - name: infely
      url-base: https://github.com/infely
    - name: xkonni
      url-base: https://github.com/xkonni
    - name: caksoylar
      url-base: https://github.com/caksoylar
  projects:
    - name: zmk
      remote: zmkfirmware
      revision: main
      import: app/west.yml
    - name: nice-view-battery
      remote: infely
      revision: main
    - name: nice-view-glyphs
      remote: xkonni
      revision: lvgl9
    - name: zmk-dongle-display
      remote: xkonni
      revision: main
    - name: zmk-keyboards-totem
      url: https://github.com/victorlucachi/zmk-keyboards-totem
      revision: main
      path: modules/zmk-keyboards-totem
    - name: zmk-rgbled-widget
      remote: caksoylar
      revision: main
      path: modules/zmk-rgbled-widget
  self:
    path: config
```
